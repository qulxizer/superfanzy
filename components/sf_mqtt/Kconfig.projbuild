## components/sf_mqtt/Kconfig.projbuild
```kconfig
menu "SF MQTT Settings"
    config SF_MQTT_ENABLED
        bool "SF Enable MQTT Module"
        default y
        help
            Enables or disables the MQTT module in the system.

    config SF_MQTT_BROKER_URI
        string "SF MQTT Broker URL"
        depends on SF_MQTT_ENABLED
        help
            MQTT broker URI to connect to.


endmenu
```

## main/Kconfig.projbuild
```kconfig
menu "WIFI Settings"
    config WIFI_ENABLED
        bool "Enable WIFI Module"
        default y
        help
            Enables or disables the WIFI module in the system. config MY_FEATURE_ENABLED

    config WIFI_SSID
        string "WIFI SSID"
        default "MyWiFiNetwork"
        depends on WIFI_ENABLED
        help
            Set the SSID (name) of the WIFI network to connect to.

    config WIFI_PASSWORD
        string "WIFI Password"
        default "MyWiFiPassword"
        depends on WIFI_ENABLED
        help
            Set the password for the WIFI network.

endmenu
```
